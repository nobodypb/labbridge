## firmware/platform/esp_idf/main/Kconfig.projbuild
```kconfig
menu "Laborbruecke"
choice LAB_BOARD
    prompt "Board"
    default LAB_BOARD_ESP32_DEVKIT if IDF_TARGET_ESP32
    default LAB_BOARD_USB_OTG if IDF_TARGET_ESP32S3
config LAB_BOARD_ESP32_DEVKIT
    bool "Classic ESP32 DevBoard (Wi-Fi, BLE and UART console)"
    depends on IDF_TARGET_ESP32
config LAB_BOARD_KNOB
    bool "Waveshare Knob (classic ESP32, display not used)"
    depends on IDF_TARGET_ESP32
config LAB_BOARD_USB_OTG
    bool "Espressif ESP32-S3-USB-OTG (USB host and UART console)"
    depends on IDF_TARGET_ESP32S3
config LAB_BOARD_STICKS3
    bool "M5Stack StickS3 (BLE and USB Serial/JTAG console)"
    depends on IDF_TARGET_ESP32S3
endchoice
config LAB_SERIAL_DIAGNOSTICS
    bool "Local USB JSON API and diagnostic console"
    default y
endmenu
config LAB_ALLOWED_PINS
    string "Explicitly approved extension GPIO numbers (comma separated)"
    default ""
```

## firmware/platform/esp_idf/sdkconfig.defaults
```kconfig
CONFIG_IDF_TARGET="esp32s3"
CONFIG_ESPTOOLPY_FLASHSIZE_8MB=y
CONFIG_PARTITION_TABLE_CUSTOM=y
CONFIG_PARTITION_TABLE_CUSTOM_FILENAME="partitions_s3.csv"
CONFIG_BT_ENABLED=y
CONFIG_BT_NIMBLE_ENABLED=y
CONFIG_BT_NIMBLE_ROLE_CENTRAL=y
CONFIG_BT_NIMBLE_ROLE_PERIPHERAL=n
CONFIG_BT_NIMBLE_MAX_CONNECTIONS=2
CONFIG_USB_HOST_HUBS_SUPPORTED=y
CONFIG_ESP_CONSOLE_UART_DEFAULT=y
CONFIG_ESP_CONSOLE_USB_SERIAL_JTAG=n
CONFIG_LAB_SERIAL_DIAGNOSTICS=y
CONFIG_ESP_MAIN_TASK_STACK_SIZE=8192
CONFIG_HTTPD_MAX_REQ_HDR_LEN=1024
CONFIG_HTTPD_MAX_URI_LEN=256
CONFIG_COMPILER_CXX_EXCEPTIONS=y

CONFIG_HTTPD_WS_SUPPORT=y
```
